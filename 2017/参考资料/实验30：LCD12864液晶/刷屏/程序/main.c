#include<reg51.h>
#include"st7565.h"

//---声明一个全局变量---//
void Delay10ms(unsigned int c);

/*******************************************************************************
* 函 数 名         : main
* 函数功能		   : 主函数
* 输    入         : 无
* 输    出         : 无
*******************************************************************************/

void main()
{
	uchar i, j;
	Lcd12864_Init();
	Lcd12864_ClearScreen();
	while(1)
	{
		//--左到右慢慢刷黑屏幕--//
		for (i=0; i<8; i++)
		{
			LcdSt7565_WriteCmd(0xB0+i); //设置Y坐标，具体可以看清屏函数里面的说明

			LcdSt7565_WriteCmd(0x10);   //设置X坐标，具体可以看清屏函数里面的说明
			LcdSt7565_WriteCmd(0x04);
			for (j=0; j<128; j++)
			{
				LcdSt7565_WriteData(0xFF);  //如果设置背景为白色时，清屏选择0XFF
				Delay10ms(1);	           //延时一下
			}
		}

		//--左到右慢慢刷白屏幕--//
		for (i=0; i<8; i++)
		{
			LcdSt7565_WriteCmd(0xB0+i); //设置Y坐标，具体可以看清屏函数里面的说明

			LcdSt7565_WriteCmd(0x10);   //设置X坐标，具体可以看清屏函数里面的说明
			LcdSt7565_WriteCmd(0x04);
			for (j=0; j<128; j++)
			{
				LcdSt7565_WriteData(0x00);  //如果设置背景为白色时，清屏选择0XFF
				Delay10ms(1);			   //延时一下
			}
		}	
	}
}

/*******************************************************************************
* 函 数 名         : Delay10ms
* 函数功能		   : 延时函数，延时10ms
* 输    入         : 无
* 输    出         : 无
*******************************************************************************/

void Delay10ms(unsigned int c)   //误差 0us
{
    unsigned char a,b;
    for(;c>0;c--)
        for(b=38;b>0;b--)
            for(a=130;a>0;a--);
}
